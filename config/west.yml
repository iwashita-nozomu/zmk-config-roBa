## config/west.yml
```yaml
manifest:
  remotes:
    - name: zmkfirmware
      url-base: https://github.com/zmkfirmware
    - name: kumamuk-git
      url-base: https://github.com/kumamuk-git
  projects:
    - name: zmk
      remote: zmkfirmware
      revision: acfd8e5ea76cf23ad1c9b6b99848f97a95224257
      import: app/west.yml
    - name: zmk-pmw3610-driver
      remote: kumamuk-git
      revision: 5e04553ab803d24405bd45621a41310ea3050e59
  self:
    path: config
```

## dts/bindings/behaviors/zmk,behavior-mouse-hold.yaml
```yaml
description: Share a pointing layer between paired holds, independently per instance
compatible: "zmk,behavior-mouse-hold"
include: zero_param.yaml

properties:
  layer:
    type: int
    required: true
    description: MOUSE_HOLD or SLOW layer index, independent of the automatic layer
```

## dts/bindings/behaviors/zmk,behavior-shared-momentary-layer.yaml
```yaml
description: Keep a layer enabled until the last matching hold is released
compatible: "zmk,behavior-shared-momentary-layer"
include: one_param.yaml
```

## dts/bindings/behaviors/zmk,behavior-shift-hold.yaml
```yaml
description: Synchronously forward Shift hold with the current release timestamp
compatible: "zmk,behavior-shift-hold"
include: zero_param.yaml

properties:
  bindings:
    type: phandle-array
    required: true
    description: One sticky-key binding carrying the Shift keycode
```

## dts/bindings/input_processors/zmk,input-processor-motion-dwell.yaml
```yaml
description: Enable an automatic layer after sustained XY motion, with cancellable requests and an idle deadline
compatible: "zmk,input-processor-motion-dwell"
include: ip_two_param.yaml

properties:
  manual-layer:
    type: int
    required: true
    description: Independently held layer; do not create automatic ownership while held
  dwell-ms:
    type: int
    required: true
    description: Minimum duration spanned by a continuous run of nonzero XY samples
  min-distance:
    type: int
    required: true
    description: Positive minimum sum of absolute X/Y input counts in the same continuous run; required together with dwell-ms for entry only
  max-gap-ms:
    type: int
    required: true
    description: A larger gap between nonzero samples starts a new run
  require-prior-idle-ms:
    type: int
    required: true
    description: Minimum time after the last keycode press before automatic activation
  excluded-positions:
    type: array
    required: true
    description: Positions that preserve active automatic ownership when pressed
  activity-layers:
    type: array
    required: true
    description: Layer indices whose highest-active controls count as pointer activity
  activity-positions:
    type: array
    required: true
    description: Pointer control positions that renew and hold an already active automatic layer
```
